/* MSPM0G3507 image linked at the start of flash (vector table at 0x0); 128 KB flash, 32 KB SRAM. */
__stack_reserve = 0x400;   /* main stack until the scheduler starts; tasks use the FreeRTOS heap */
MEMORY
{
  FLASH (rx)  : ORIGIN = @APP_ORIGIN@, LENGTH = @APP_LENGTH@
  SRAM  (rwx) : ORIGIN = 0x20200000, LENGTH = 32K
}
INCLUDE common.ld
